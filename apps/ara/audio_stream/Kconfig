## apps/ara/audio_stream/Kconfig
```kconfig
#
# For a description of the syntax of this configuration file,
# see misc/tools/kconfig-language.txt.
#

config ARA_AUDIO_STREAM
	bool "Ara AUDIO STREAM Test Program"
	default n
	---help---
        Enable the Toshiba I2S low-level device driver test program.
        Note that this program does not exit.

if ARA_AUDIO_STREAM

config ARA_AUDIO_STREAM_PROGNAME
	string "Program name"
	default "audio_stream"
	depends on BUILD_KERNEL
	---help---
		This is the name of the program that will be used when the
		NSH ELF program is installed.

endif
```

## apps/greybus-utils/Kconfig
```kconfig
############################################################################
#
#   Copyright (c) 2014, 2015 Google Inc.
#   All rights reserved.
#
# Redistribution and use in source and binary forms, with or without
# modification, are permitted provided that the following conditions
# are met:
#
# 1. Redistributions of source code must retain the above copyright
#    notice, this list of conditions and the following disclaimer.
# 2. Redistributions in binary form must reproduce the above copyright
#    notice, this list of conditions and the following disclaimer in
#    the documentation and/or other materials provided with the
#    distribution.
# 3. Neither the name NuttX nor the names of its contributors may be
#    used to endorse or promote products derived from this software
#    without specific prior written permission.
#
# THIS SOFTWARE IS PROVIDED BY THE COPYRIGHT HOLDERS AND CONTRIBUTORS
# "AS IS" AND ANY EXPRESS OR IMPLIED WARRANTIES, INCLUDING, BUT NOT
# LIMITED TO, THE IMPLIED WARRANTIES OF MERCHANTABILITY AND FITNESS
# FOR A PARTICULAR PURPOSE ARE DISCLAIMED. IN NO EVENT SHALL THE
# COPYRIGHT OWNER OR CONTRIBUTORS BE LIABLE FOR ANY DIRECT, INDIRECT,
# INCIDENTAL, SPECIAL, EXEMPLARY, OR CONSEQUENTIAL DAMAGES (INCLUDING,
# BUT NOT LIMITED TO, PROCUREMENT OF SUBSTITUTE GOODS OR SERVICES; LOSS
# OF USE, DATA, OR PROFITS; OR BUSINESS INTERRUPTION) HOWEVER CAUSED
# AND ON ANY THEORY OF LIABILITY, WHETHER IN CONTRACT, STRICT
# LIABILITY, OR TORT (INCLUDING NEGLIGENCE OR OTHERWISE) ARISING IN
# ANY WAY OUT OF THE USE OF THIS SOFTWARE, EVEN IF ADVISED OF THE
# POSSIBILITY OF SUCH DAMAGE.
#
############################################################################
#
# For a description of the syntax of this configuration file,
# see misc/tools/kconfig-language.txt.
#

config GREYBUS_DEBUG
  bool "Enable verbose log"

choice
  prompt "Select a predefined Manifest"
config MANIFEST_GPIO
  bool "GPIO"
config MANIFEST_I2C
  bool "I2C"
config MANIFEST_GPIO_I2C
  bool "I2C and GPIO"
config MANIFEST_BATTERY_GPIO_I2C
  bool "Battery, GPIO and I2C"
config MANIFEST_LOOPBACK
  bool "Loopback"
config MANIFEST_VIBRATOR
  bool "Vibrator"
config MANIFEST_GPIO_I2C_VIBRATOR
  bool "GPIO, I2C, and Vibrator"
config CUSTOM_MANIFEST
  bool "Custom manifest"
endchoice

config MANIFEST
  string "manifest name"
  depends on CUSTOM_MANIFEST

config SVC_MSG
  bool "Enable Greybus SVC Protocol"
```

## nuttx/configs/ara/svc/Kconfig
```kconfig
#
# For a description of the syntax of this configuration file,
# see misc/tools/kconfig-language.txt.
#

choice
	prompt "Select a route config"
config SVC_ROUTE_DEFAULT
	bool "APB1 to APB2"
config SVC_ROUTE_SPRING6_APB2
	bool "AP Module to APB2"
endchoice

config ARA_DUAL_I2S_PORTS
	bool "Dual I2S routing to APB2"
	default n
	---help---
        Enable the dual I2S CPorts on APB2.

config ARA_STREAM_FROM_APB3_TO_APB2
	bool "Stream I2S to APB2 from APB3"
	depends on ARA_DUAL_I2S_PORTS
	default n
	---help---
        Enable the streaming an audio from APB3 to APB2.
```

## nuttx/configs/bdb/Kconfig
```kconfig
#
# For a description of the syntax of this configuration file,
# see misc/tools/kconfig-language.txt.
#

if ARCH_BOARD_BDB

config APB1
	bool "APBridge1 on BDB"
	depends on ARCH_CHIP_TSB
	default y
	---help---
		Select if you are building for APB1 on the BDB.

config GREYBUS_I2S_DUAL_PORTS
	bool "Dual I2S routing to APB2"
	select GREYBUS_I2S_UPSCALE
	default n
	---help---
        Enable the dual I2S CPorts on APB2.

endif
```
